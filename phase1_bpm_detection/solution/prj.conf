## CMakeLists.txt
```
cmake_minimum_required(VERSION 3.20.0)
find_package(Zephyr REQUIRED HINTS $ENV{ZEPHYR_BASE})

project(phase1_sensor_test)

# Include path for pulse_sensor library
target_include_directories(app PRIVATE ../../lib/pulse_sensor)

# Source files
target_sources(app PRIVATE
    src/main.c
    ../../lib/pulse_sensor/pulse_sensor.c
)
```

## prj.conf
```kconfig
# Logging
CONFIG_LOG=y
CONFIG_LOG_DEFAULT_LEVEL=3

# Console output
CONFIG_CONSOLE=y
CONFIG_UART_CONSOLE=y
CONFIG_SERIAL=y

# ADC using Zephyr API (handles nRF54L15 quirks)
CONFIG_ADC=y

# For accurate power measurements (Module 8), change CONFIG_LOG=y to CONFIG_LOG=n
# above and uncomment the three lines below to fully disable UART.
# CONFIG_SERIAL=n
# CONFIG_CONSOLE=n
# CONFIG_UART_CONSOLE=n
```

## boards/nrf54l15dk_nrf54l15_cpuapp.overlay
```dts
/*
 * Devicetree overlay for Pulse Sensor on P1.11 (AIN4)
 * Based on Nordic's nRF54L15 ADC test overlays
 */

/ {
    zephyr,user {
        io-channels = <&adc 0>;
    };
};

&adc {
    #address-cells = <1>;
    #size-cells = <0>;
    status = "okay";

    channel@0 {
        reg = <0>;
        zephyr,gain = "ADC_GAIN_1_4";
        zephyr,reference = "ADC_REF_INTERNAL";
        zephyr,acquisition-time = <ADC_ACQ_TIME_DEFAULT>;
        zephyr,input-positive = <NRF_SAADC_AIN4>;  /* P1.11 */
        zephyr,resolution = <12>;
    };
};
```

## src/main.c
```c
/*
 * Phase 1: Beat Detection using PulseSensor Algorithm
 *
 * Builds on Phase 0 by adding the PulseSensor beat detection algorithm.
 * Algorithm ported from: https://github.com/WorldFamousElectronics/PulseSensorPlayground
 *
 * Note: For reliable readings, use the velcro strap to maintain consistent
 * pressure and block ambient light. See the PulseSensor Getting Started Guide.
 *
 * Wiring: Same as Phase 0
 *   Pulse Sensor Signal (S) -> P1.11 (AIN4)
 *   Pulse Sensor VCC (+)    -> 3.3V
 *   Pulse Sensor GND (-)    -> GND
 */

#include <zephyr/kernel.h>
#include <zephyr/device.h>
#include <zephyr/devicetree.h>
#include <zephyr/drivers/adc.h>
#include <zephyr/logging/log.h>

#include "pulse_sensor.h"

LOG_MODULE_REGISTER(pulse, LOG_LEVEL_INF);

/* 200 Hz sampling for beat detection algorithm */
#define SAMPLE_INTERVAL_MS  5

/* Initial threshold for 12-bit ADC (algorithm will auto-adapt) */
#define INITIAL_THRESHOLD   2200

#if !DT_NODE_EXISTS(DT_PATH(zephyr_user)) || \
    !DT_NODE_HAS_PROP(DT_PATH(zephyr_user), io_channels)
#error "Devicetree overlay required"
#endif

static const struct adc_dt_spec adc_channel = ADC_DT_SPEC_GET_BY_IDX(DT_PATH(zephyr_user), 0);

/* PulseSensor state */
static pulse_sensor_t pulse;

int main(void)
{
	int err;
	uint16_t buf;
	struct adc_sequence sequence = {
		.buffer = &buf,
		.buffer_size = sizeof(buf),
	};

	LOG_INF("Phase 1: Beat Detection");

	if (!adc_is_ready_dt(&adc_channel)) {
		LOG_ERR("ADC device not ready");
		return -1;
	}

	err = adc_channel_setup_dt(&adc_channel);
	if (err < 0) {
		LOG_ERR("ADC channel setup failed (%d)", err);
		return err;
	}

	/* Initialize PulseSensor algorithm */
	pulse_sensor_init(&pulse, INITIAL_THRESHOLD, SAMPLE_INTERVAL_MS);

	LOG_INF("Place finger on sensor...");

	while (1) {
		adc_sequence_init_dt(&adc_channel, &sequence);

		err = adc_read_dt(&adc_channel, &sequence);
		if (err < 0) {
			k_msleep(SAMPLE_INTERVAL_MS);
			continue;
		}

		/* Process through beat detection algorithm */
		bool beat = pulse_sensor_process(&pulse, (int16_t)buf);

		if (beat) {
			LOG_INF("BPM: %d", pulse_sensor_get_bpm(&pulse));
		}

		k_msleep(SAMPLE_INTERVAL_MS);
	}

	return 0;
}
```
